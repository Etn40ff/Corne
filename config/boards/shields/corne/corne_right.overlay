#include "corne.dtsi"

&default_transform {
    col-offset = <6>;
};

right_encoder: encoder_right {
    compatible = "alps,ec11";
    a-gpios = <15 (GPIO_ACTIVE_HIGH | GPIO_PULL_UP)>;
    b-gpios = <14 (GPIO_ACTIVE_HIGH | GPIO_PULL_UP)>;
    steps = <80>;
    status = "okay";
};

sensors: sensors {
    compatible = "zmk,keymap-sensors";
    sensors = <&right_encoder>;
    triggers-per-rotation = <20>;
};

&kscan0 {
    row-gpios = <&pro_micro 21 (GPIO_ACTIVE_HIGH | GPIO_PULL_DOWN)>,
        <&pro_micro 20 (GPIO_ACTIVE_HIGH | GPIO_PULL_DOWN)>,
        <&pro_micro 19 (GPIO_ACTIVE_HIGH | GPIO_PULL_DOWN)>,
        <&pro_micro 18 (GPIO_ACTIVE_HIGH | GPIO_PULL_DOWN)>;

    col-gpios = <&pro_micro 2 GPIO_ACTIVE_HIGH>,
        <&pro_micro 3 GPIO_ACTIVE_HIGH>,
        <&pro_micro 4 GPIO_ACTIVE_HIGH>,
        <&pro_micro 5 GPIO_ACTIVE_HIGH>,
        <&pro_micro 6 GPIO_ACTIVE_HIGH>,
        <&pro_micro 7 GPIO_ACTIVE_HIGH>;
};
